## kernel/Kconfig.rros
```kconfig
config HAVE_ARCH_RROS
	bool

menuconfig RROS
	bool "Rust Real-time Core"
	depends on HAVE_ARCH_RROS
	select DOVETAIL
	select DEVTMPFS

	help

		The RROS core is a real-time component of the Linux Kernel,
		which delivers very short and bounded response time to
		interrupt and task events. RROS runs asynchronously to the
		common kernel services, on the hihg-priority, out-of-band
		stage managed by the Dovetail layer.

if RROS

source "kernel/rros/Kconfig"

if WARN_CPUFREQ_GOVERNOR
comment "WARNING! CPU_FREQ governors other than 'performance'"
comment "or 'powersave' may significantly increase latency"
comment "on this platform during the frequency transitions"
endif

endif
```
